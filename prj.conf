## CMakeLists.txt
```
cmake_minimum_required(VERSION 3.20.0)
find_package(Zephyr REQUIRED HINTS $ENV{ZEPHYR_BASE})
project(6sens_rtos_blinky)

target_sources(app PRIVATE src/main.c)
```

## prj.conf
```kconfig
# Debugger Support
CONFIG_UART_CONSOLE=n
CONFIG_CONSOLE=y
CONFIG_SERIAL=y

# RTT Segger Support
CONFIG_RTT_CONSOLE=n
CONFIG_USE_SEGGER_RTT=n

# Communication Bus Support
CONFIG_GPIO=y
```

## src/main.c
```c
/*
 * Copyright (c) 2026
 * Regis Rousseau
 * Univ Lyon, INSA Lyon, Inria, CITI, EA3720
 * SPDX-License-Identifier: Apache-2.0
 */

//  ========== includes ====================================================================
#include <zephyr/kernel.h>
#include <zephyr/device.h>
#include <zephyr/devicetree.h>
#include <zephyr/drivers/gpio.h>
#include <zephyr/drivers/uart.h>
#include <zephyr/sys/printk.h>

//  ========== defines =====================================================================
// time in milliseconds to wait between LED toggles (2000 ms = 2 seconds)
#define SLEEP_TIME_MS   2000

// device tree node identifiers for the LEDs
#define LED_0 DT_ALIAS(led0)

//  ========== globals =====================================================================
// define GPIO configurations for the LEDs
static const struct gpio_dt_spec led_0 = GPIO_DT_SPEC_GET(LED_0, gpios);

//  ========== main ========================================================================
int8_t main(void)
{
	int8_t ret;
	
	// test if GPIO is ready to use
	if (!gpio_is_ready_dt(&led_0)) {
        return 0;
    }

	// configure the LEDs as active output pins
	gpio_pin_configure_dt(&led_0, GPIO_OUTPUT_ACTIVE);

	// turn off both LEDs initially
	gpio_pin_set_dt(&led_0, 0);

	// infinite loop to toggle LEDs and print status
	while (1) {
		// print "Hello World" message with the board configuration name
		printk("Hello World! %s\n", CONFIG_BOARD);

		// toggle the LED and check for errors
		ret = gpio_pin_toggle_dt(&led_0);
		if (ret < 0) {
			return 0;
		}
		// wait for the defined sleep time before toggling again
		k_msleep(SLEEP_TIME_MS);
	}
	return 0;
}
```
